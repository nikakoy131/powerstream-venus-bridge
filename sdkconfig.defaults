## sdkconfig.defaults
```kconfig
# BLE — NimBLE, observer + central only
CONFIG_BT_ENABLED=y
CONFIG_BT_NIMBLE_ENABLED=y
CONFIG_BT_NIMBLE_ROLE_OBSERVER=y
CONFIG_BT_NIMBLE_ROLE_CENTRAL=y
CONFIG_BT_NIMBLE_ROLE_PERIPHERAL=n
CONFIG_BT_NIMBLE_ROLE_BROADCASTER=n

# WiFi — enable SoftAP support
CONFIG_ESP_WIFI_SOFTAP_SUPPORT=y

# Flash: 4MB (ESP32-C6FH4)
CONFIG_ESPTOOLPY_FLASHSIZE_4MB=y

# Increase NimBLE host task stack (BLE + crypto)
CONFIG_BT_NIMBLE_HOST_TASK_STACK_SIZE=5120

# Socket fd pool is shared by httpd (2 internal + sessions) and Modbus
# (listener + client); the default 10 exhausts in the field (accept ENFILE).
CONFIG_LWIP_MAX_SOCKETS=16
```
